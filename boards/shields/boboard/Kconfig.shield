## boards/shields/boboard/Kconfig.shield
```kconfig
config SHIELD_BOBOARD_LEFT
    def_bool $(shields_list_contains,boboard_left)

config SHIELD_BOBOARD_RIGHT
    def_bool $(shields_list_contains,boboard_right)
```
